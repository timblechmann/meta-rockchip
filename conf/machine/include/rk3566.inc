## conf/machine/include/rk3566.inc
```bitbake
require conf/machine/include/rk356x.inc

SOC_FAMILY = "rk3566"
MACHINEOVERRIDES =. "rk3566:"
KERNEL_FEATURES:append:rk3566 = " bsp/rockchip/remove-non-rockchip-arch-arm64.scc"
```

## conf/machine/include/rk3568.inc
```bitbake
require conf/machine/include/rk356x.inc

SOC_FAMILY = "rk3568"
MACHINEOVERRIDES =. "rk3568:"
KERNEL_FEATURES:append:rk3568 = " bsp/rockchip/remove-non-rockchip-arch-arm64.scc"
```

## conf/machine/radxa-e25.conf
```bitbake
#@TYPE: Machine
#@NAME: Radxa E25
#@DESCRIPTION: Radxa E25 is a network application carrier board for CM3I designed by Radxa.
#https://wiki.radxa.com/Rock3/CM/CM3I/E25

require conf/machine/include/rk3568.inc

KERNEL_DEVICETREE = "rockchip/rk3568-radxa-e25.dtb"
MACHINE_EXTRA_RRECOMMENDS += "kernel-modules"

UBOOT_MACHINE = "radxa-e25-rk3568_defconfig"
```

## conf/machine/rockchip-rk3399-rock-4se.conf
```bitbake
# Copyright (c) 2019, Fuzhou Rockchip Electronics Co., Ltd
# Copyright (c) 2023, Radxa Ltd
# Released under the MIT license (see COPYING.MIT for the terms)

#@TYPE: Machine
#@NAME: RK3399 ROCK 4 SE

require conf/machine/include/rk3399.inc

KERNEL_DEVICETREE = "rockchip/rk3399-rock-4se.dtb"

UBOOT_MACHINE = "evb-rk3399_defconfig"

MACHINE_EXTRA_RRECOMMENDS:append = " \
	linux-firmware-rk-cdndp \
"
```

## conf/machine/rockchip-rk3566-radxa-cm3-io.conf
```bitbake
# Copyright (c) 2022, Radxa Ltd
# Released under the MIT license (see COPYING.MIT for the terms)

#@TYPE: Machine
#@NAME: RK3566 Radxa CM3 IO

require conf/machine/include/rk356x.inc

KERNEL_DEVICETREE = "rockchip/rk3566-radxa-cm3-io.dtb"

UBOOT_MACHINE = "rk3568_defconfig"

MACHINE_EXTRA_RRECOMMENDS:append = " \
	drm-cursor \
"
```

## conf/machine/rockchip-rk3568-rock-3a.conf
```bitbake
# Copyright (c) 2023, Radxa Ltd
# Released under the MIT license (see COPYING.MIT for the terms)

#@TYPE: Machine
#@NAME: RK3568 ROCK 3A

require conf/machine/include/rk356x.inc

KERNEL_DEVICETREE = "rockchip/rk3568-rock-3a.dtb"

UBOOT_MACHINE = "rk3568_defconfig"

MACHINE_EXTRA_RRECOMMENDS:append = " \
	drm-cursor \
"
```

## conf/machine/rockchip-rk3588-rock-5b.conf
```bitbake
# Copyright (c) 2024, Radxa Limited
# Released under the MIT license (see COPYING.MIT for the terms)

#@TYPE: Machine
#@NAME: RK3588 ROCK 5B

require conf/machine/include/rk3588.inc

PREFERRED_VERSION_linux-rockchip := "6.1%"
LINUXLIBCVERSION := "6.1-custom%"
OLDEST_KERNEL := "6.1"

KERNEL_DEVICETREE = "rockchip/rk3588-rock-5b.dtb"

UBOOT_MACHINE = "rk3588_defconfig"
```

## conf/machine/rockchip-rk3588s-radxa-cm5-io.conf
```bitbake
# Copyright (c) 2024, Radxa Limited
# Released under the MIT license (see COPYING.MIT for the terms)

#@TYPE: Machine
#@NAME: RK3588S Radxa CM5 IO

require conf/machine/include/rk3588.inc

PREFERRED_VERSION_linux-rockchip := "6.1%"
LINUXLIBCVERSION := "6.1-custom%"
OLDEST_KERNEL := "6.1"

KERNEL_DEVICETREE = "rockchip/rk3588s-radxa-cm5-io.dtb"

UBOOT_MACHINE = "rk3588_defconfig"
```

## conf/machine/rockchip-rk3588s-radxa-nx5-io.conf
```bitbake
# Copyright (c) 2022, Radxa Ltd
# Released under the MIT license (see COPYING.MIT for the terms)

#@TYPE: Machine
#@NAME: RK3588S Radxa NX5 IO

require conf/machine/include/rk3588.inc

KERNEL_DEVICETREE = "rockchip/rk3588s-radxa-nx5-io.dtb"

UBOOT_MACHINE = "rk3588_defconfig"
```

## conf/machine/rockchip-rk3588s-radxa-nx5.conf
```bitbake
# Copyright (c) 2022, Radxa Ltd
# Released under the MIT license (see COPYING.MIT for the terms)

#@TYPE: Machine
#@NAME: RK3588S Radxa NX5

require conf/machine/include/rk3588.inc

KERNEL_DEVICETREE = "rockchip/rk3588s-radxa-nx5.dtb"

UBOOT_MACHINE = "rk3588_defconfig"
```

## conf/machine/rockchip-rk3588s-rock-5c.conf
```bitbake
# Copyright (c) 2024, Radxa Limited
# Released under the MIT license (see COPYING.MIT for the terms)

#@TYPE: Machine
#@NAME: RK3588S ROCK 5C

require conf/machine/include/rk3588.inc

PREFERRED_VERSION_linux-rockchip := "6.1%"
LINUXLIBCVERSION := "6.1-custom%"
OLDEST_KERNEL := "6.1"

KERNEL_DEVICETREE = "rockchip/rk3588s-rock-5c.dtb"

UBOOT_MACHINE = "rk3588_defconfig"
```
